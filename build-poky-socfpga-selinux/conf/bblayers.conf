## build-poky-socfpga-selinux/conf/bblayers.conf
```bitbake
# POKY_BBLAYERS_CONF_VERSION is increased each time build/conf/bblayers.conf
# changes incompatibly
POKY_BBLAYERS_CONF_VERSION = "2"

BBPATH = "${TOPDIR}"
BBFILES ?= ""

BBLAYERS ?= " \
  ${TOPDIR}/../layers/poky/meta \
  ${TOPDIR}/../layers/poky/meta-poky \
  ${TOPDIR}/../layers/poky/meta-yocto-bsp \
  "
BBLAYERS += " ${TOPDIR}/../layers/meta-intel-fpga "
BBLAYERS += " ${TOPDIR}/../layers/meta-intel-fpga-refdes "
BBLAYERS += " ${TOPDIR}/../layers/meta-openembedded/meta-oe "
BBLAYERS += " ${TOPDIR}/../layers/meta-openembedded/meta-networking "
BBLAYERS += " ${TOPDIR}/../layers/meta-openembedded/meta-python "
BBLAYERS += " ${TOPDIR}/../layers/meta-selinux "
```
